## sdkconfig.defaults
```kconfig
CONFIG_IDF_TARGET="esp32c6"

# Arduino ESP32 settings 
CONFIG_BOOTLOADER_LOG_LEVEL_INFO=y
CONFIG_AUTOSTART_ARDUINO=y
CONFIG_ARDUHAL_LOG_DEFAULT_LEVEL_WARN=y
CONFIG_LOG_DEFAULT_LEVEL_INFO=y
CONFIG_LOG_DEFAULT_LEVEL=3
CONFIG_ESP_CONSOLE_USB_SERIAL_JTAG=y

# CHIP logging (raise default to Progress so non-error CHIP logs appear)
CONFIG_CHIP_LOG_DEFAULT_LEVEL_EQUALS_LOG_DEFAULT_LEVEL=n
CONFIG_CHIP_LOG_DEFAULT_LEVEL_PROGRESS=y
CONFIG_CHIP_LOG_DEFAULT_LEVEL=2
CONFIG_CHIP_LOG_FILTERING=y

# Enables Arduino Selective Library Compilation: Arduino Matter + Preferences Library
CONFIG_ARDUINO_SELECTIVE_COMPILATION=y
CONFIG_ARDUINO_SELECTIVE_Preferences=y
CONFIG_ARDUINO_SELECTIVE_Network=y
CONFIG_ARDUINO_SELECTIVE_ESPmDNS=y
CONFIG_ARDUINO_SELECTIVE_Matter=y

# Use a custom partition table
CONFIG_PARTITION_TABLE_CUSTOM=y
CONFIG_PARTITION_TABLE_CUSTOM_FILENAME="partitions.csv"
CONFIG_PARTITION_TABLE_OFFSET=0xC000

# Flash Configuration
CONFIG_ESPTOOLPY_FLASHMODE_QIO=y
CONFIG_ESPTOOLPY_FLASH_SAMPLE_MODE_STR=y
CONFIG_ESPTOOLPY_FLASHMODE="dio"
CONFIG_ESPTOOLPY_FLASHFREQ_80M=y
CONFIG_ESPTOOLPY_FLASHFREQ="80m"
CONFIG_ESPTOOLPY_FLASHSIZE_4MB=y
CONFIG_ESPTOOLPY_FLASHSIZE="4MB"
CONFIG_ESPTOOLPY_HEADER_FLASHSIZE_UPDATE=y
CONFIG_ESPTOOLPY_BEFORE_RESET=y
CONFIG_ESPTOOLPY_BEFORE="default_reset"
CONFIG_ESPTOOLPY_AFTER_RESET=y
CONFIG_ESPTOOLPY_AFTER="hard_reset"
CONFIG_ESPTOOLPY_MONITOR_BAUD=115200

# BLE
CONFIG_BT_ENABLED=y
CONFIG_BT_NIMBLE_ENABLED=y
CONFIG_BT_NIMBLE_ENABLE_CONN_REATTEMPT=n
CONFIG_BT_LE_SLEEP_ENABLE=y
CONFIG_ESP_PHY_MAC_BB_PD=y

# Power Management
CONFIG_PM_ENABLE=y
CONFIG_PM_DFS_INIT_AUTO=y
CONFIG_PM_POWER_DOWN_PERIPHERAL_IN_LIGHT_SLEEP=y

# Disable Wi-Fi
CONFIG_ESP_WIFI_SOFTAP_SUPPORT=n
CONFIG_ENABLE_WIFI_STATION=n
CONFIG_ENABLE_WIFI_AP=n

# FreeRTOS
CONFIG_FREERTOS_HZ=1000
CONFIG_FREERTOS_ENABLE_BACKWARD_COMPATIBILITY=y
CONFIG_FREERTOS_USE_TICKLESS_IDLE=y

# IEEE802.15.4
CONFIG_IEEE802154_SLEEP_ENABLE=y

# LwIP
CONFIG_LWIP_ND6=y
CONFIG_LWIP_IPV4=y
CONFIG_LWIP_IPV6_NUM_ADDRESSES=8
CONFIG_LWIP_MULTICAST_PING=y

# MbedTLS
CONFIG_MBEDTLS_SSL_PROTO_DTLS=y
CONFIG_MBEDTLS_HKDF_C=y

# NIMBLE
CONFIG_BT_NIMBLE_EXT_ADV=n
CONFIG_BT_NIMBLE_TRANSPORT_EVT_SIZE=70
CONFIG_USE_BLE_ONLY_FOR_COMMISSIONING=n

# Enable OpenThread
CONFIG_OPENTHREAD_ENABLED=y
CONFIG_OPENTHREAD_SRP_CLIENT=y
CONFIG_OPENTHREAD_DNS_CLIENT=y
CONFIG_OPENTHREAD_LOG_LEVEL_DYNAMIC=n
CONFIG_OPENTHREAD_LOG_LEVEL_NOTE=y
CONFIG_OPENTHREAD_MTD=y
CONFIG_OPENTHREAD_CLI=n

# Enable HKDF in mbedtls
CONFIG_MBEDTLS_HKDF_C=y

# Matter over Thread + BLE commissioning
CONFIG_ENABLE_MATTER_OVER_THREAD=y
CONFIG_ENABLE_CHIPOBLE=y

# MDNS platform
CONFIG_USE_MINIMAL_MDNS=n

# ICD server
CONFIG_ENABLE_ICD_SERVER=y

# MDNS platform
CONFIG_ENABLE_EXTENDED_DISCOVERY=y

# Device identity
CONFIG_CHIP_PROJECT_CONFIG="main/chip_project_config.h"
CONFIG_USE_TEST_SERIAL_NUMBER="001"
CONFIG_DEVICE_SOFTWARE_VERSION_NUMBER=600
CONFIG_DEFAULT_DEVICE_HARDWARE_VERSION=11

# LIT ICD overrides
CONFIG_ENABLE_ICD_LIT=y
CONFIG_ENABLE_ICD_CIP=y
CONFIG_ENABLE_ICD_USER_ACTIVE_MODE_TRIGGER=y
CONFIG_ICD_SLOW_POLL_INTERVAL_MS=20000
CONFIG_ICD_IDLE_MODE_INTERVAL_SEC=600
CONFIG_ICD_ACTIVE_MODE_THRESHOLD_MS=5000
CONFIG_ICD_CLIENTS_SUPPORTED_PER_FABRIC=2
CONFIG_ICD_MAX_NOTIFICATION_SUBSCRIBERS=2
```

## sdkconfig.defaults.ipv4off
```kconfig
CONFIG_IDF_TARGET="esp32c6"
CONFIG_ESPTOOLPY_FLASHSIZE_4MB=y

# BLE
CONFIG_BT_ENABLED=y
CONFIG_BT_NIMBLE_ENABLED=y
CONFIG_BT_NIMBLE_ENABLE_CONN_REATTEMPT=n
CONFIG_BT_LE_SLEEP_ENABLE=y
CONFIG_BT_LE_LP_CLK_SRC_MAIN_XTAL=y

# Power management
CONFIG_PM_ENABLE=y
CONFIG_PM_DFS_INIT_AUTO=y
CONFIG_PM_POWER_DOWN_PERIPHERAL_IN_LIGHT_SLEEP=y
CONFIG_ESP_SLEEP_POWER_DOWN_FLASH=y
CONFIG_ESP_PHY_MAC_BB_PD=y

# FreeRTOS
CONFIG_FREERTOS_HZ=1000
CONFIG_FREERTOS_USE_TICKLESS_IDLE=y

# Thread + IEEE 802.15.4
CONFIG_OPENTHREAD_ENABLED=y
CONFIG_OPENTHREAD_SRP_CLIENT=y
CONFIG_OPENTHREAD_LOG_LEVEL_DYNAMIC=n
CONFIG_OPENTHREAD_LOG_LEVEL_NOTE=y
CONFIG_OPENTHREAD_MTD=y
CONFIG_OPENTHREAD_CLI=n
CONFIG_IEEE802154_SLEEP_ENABLE=y

# Matter + commissioning
CONFIG_ENABLE_MATTER_OVER_THREAD=y
CONFIG_ENABLE_CHIPOBLE=y

# LwIP / IPv4 off
CONFIG_DISABLE_IPV4=y
CONFIG_LWIP_IPV4=n
CONFIG_LWIP_ND6=n
CONFIG_LWIP_IPV6_AUTOCONFIG=n
CONFIG_LWIP_IPV6_NUM_ADDRESSES=8
CONFIG_LWIP_MULTICAST_PING=y

# Wi-Fi off
CONFIG_ENABLE_WIFI_STATION=n
CONFIG_ENABLE_WIFI_AP=n
CONFIG_ESP_WIFI_SOFTAP_SUPPORT=n

# mbedTLS
CONFIG_MBEDTLS_HKDF_C=y
CONFIG_MBEDTLS_SSL_PROTO_DTLS=y

# mDNS
CONFIG_USE_MINIMAL_MDNS=n

# OTA Requestor
CONFIG_ENABLE_OTA_REQUESTOR=y

# Partitions
CONFIG_PARTITION_TABLE_CUSTOM=y
CONFIG_PARTITION_TABLE_FILENAME="partitions.csv"
CONFIG_PARTITION_TABLE_OFFSET=0xC000

# ICD (SIT)
CONFIG_ENABLE_ICD_SERVER=y
CONFIG_ICD_FAST_POLL_INTERVAL_MS=500
CONFIG_ICD_IDLE_MODE_INTERVAL_SEC=60
CONFIG_ICD_ACTIVE_MODE_INTERVAL_MS=1000
CONFIG_ICD_ACTIVE_MODE_THRESHOLD_MS=1000

# Modbus (disable TCP mode to avoid IPv4 dependencies)
CONFIG_FMB_COMM_MODE_TCP_EN=n

# Matter dynamic endpoints
CONFIG_ESP_MATTER_MAX_DYNAMIC_ENDPOINT_COUNT=4

# Device identity
CONFIG_RTC_CLK_SRC_EXT_CRYS=n
CONFIG_CHIP_PROJECT_CONFIG="main/chip_project_config.h"
CONFIG_USE_TEST_SERIAL_NUMBER="001"
CONFIG_DEVICE_SOFTWARE_VERSION_NUMBER=502
CONFIG_DEFAULT_DEVICE_HARDWARE_VERSION=11
```

## sdkconfig.defaults.lit
```kconfig
# TinyENV Sensor - minimal defaults (LIT ICD)
CONFIG_IDF_TARGET="esp32c6"

# Partitions
CONFIG_PARTITION_TABLE_CUSTOM=y
CONFIG_PARTITION_TABLE_FILENAME="partitions.csv"
CONFIG_PARTITION_TABLE_OFFSET=0xC000

# Power management
CONFIG_PM_ENABLE=y
CONFIG_PM_DFS_INIT_AUTO=y
CONFIG_PM_POWER_DOWN_PERIPHERAL_IN_LIGHT_SLEEP=y
CONFIG_ESP_SLEEP_POWER_DOWN_FLASH=y
CONFIG_FREERTOS_HZ=1000
CONFIG_FREERTOS_USE_TICKLESS_IDLE=y
CONFIG_FREERTOS_ENABLE_BACKWARD_COMPATIBILITY=y

# Thread + IEEE 802.15.4 sleep
CONFIG_OPENTHREAD_ENABLED=y
CONFIG_OPENTHREAD_MTD=y
CONFIG_OPENTHREAD_CLI=n
CONFIG_OPENTHREAD_LOG_LEVEL_DYNAMIC=n
CONFIG_OPENTHREAD_LOG_LEVEL_NOTE=y
CONFIG_IEEE802154_SLEEP_ENABLE=y

# Matter over Thread + commissioning
CONFIG_ENABLE_MATTER_OVER_THREAD=y
CONFIG_ENABLE_CHIPOBLE=y

# BLE sleep
CONFIG_BT_ENABLED=y
CONFIG_BT_NIMBLE_ENABLED=y
CONFIG_BT_NIMBLE_ENABLE_CONN_REATTEMPT=n
CONFIG_BT_LE_SLEEP_ENABLE=y
CONFIG_BT_LE_LP_CLK_SRC_MAIN_XTAL=y

# LwIP / IPv4 off
CONFIG_DISABLE_IPV4=y
CONFIG_LWIP_IPV4=n
CONFIG_LWIP_ND6=n
CONFIG_LWIP_IPV6_AUTOCONFIG=n
CONFIG_LWIP_IPV6_NUM_ADDRESSES=8
CONFIG_LWIP_MULTICAST_PING=y

# Wi-Fi off
CONFIG_ENABLE_WIFI_STATION=n
CONFIG_ENABLE_WIFI_AP=n
CONFIG_ESP_WIFI_SOFTAP_SUPPORT=n

# mbedTLS
CONFIG_MBEDTLS_HKDF_C=y
CONFIG_MBEDTLS_SSL_PROTO_DTLS=y

# mDNS
CONFIG_USE_MINIMAL_MDNS=n

# ICD (LIT)
CONFIG_ENABLE_ICD_SERVER=y
CONFIG_ENABLE_ICD_LIT=y
CONFIG_ICD_SLOW_POLL_INTERVAL_MS=20000
CONFIG_ICD_FAST_POLL_INTERVAL_MS=500
CONFIG_ICD_IDLE_MODE_INTERVAL_SEC=600
CONFIG_ICD_ACTIVE_MODE_INTERVAL_MS=1000
CONFIG_ICD_ACTIVE_MODE_THRESHOLD_MS=5000
CONFIG_ICD_CLIENTS_SUPPORTED_PER_FABRIC=2
CONFIG_ICD_MAX_NOTIFICATION_SUBSCRIBERS=2

# Misc
CONFIG_ESP_PHY_MAC_BB_PD=y
CONFIG_RTC_CLK_SRC_EXT_CRYS=n
```
